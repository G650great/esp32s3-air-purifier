#include "oled.h"
#include "driver/i2c.h"
#include "driver/gpio.h"
#include "esp_log.h"
#include "esp_rom_sys.h"
#include <string.h>
#include <stdlib.h>

static const char *TAG = "OLED";

#define I2C_MASTER_SCL_IO   GPIO_NUM_9
#define I2C_MASTER_SDA_IO   GPIO_NUM_8
#define I2C_MASTER_NUM      I2C_NUM_0
#define I2C_MASTER_FREQ_HZ  400000
#define OLED_ADDR           0x3C

static uint8_t oled_buffer[OLED_WIDTH * OLED_HEIGHT / 8];
static int current_font_size = 0;

static void i2c_master_init(void) {
    i2c_config_t conf = {
        .mode = I2C_MODE_MASTER,
        .sda_io_num = I2C_MASTER_SDA_IO,
        .scl_io_num = I2C_MASTER_SCL_IO,
        .sda_pullup_en = GPIO_PULLUP_ENABLE,
        .scl_pullup_en = GPIO_PULLUP_ENABLE,
        .master.clk_speed = I2C_MASTER_FREQ_HZ,
    };
    i2c_param_config(I2C_MASTER_NUM, &conf);
    i2c_driver_install(I2C_MASTER_NUM, conf.mode, 0, 0, 0);
}

static esp_err_t i2c_write_cmd(uint8_t cmd) {
    uint8_t buf[2] = {0x00, cmd};
    return i2c_master_write_to_device(I2C_MASTER_NUM, OLED_ADDR, buf, 2, pdMS_TO_TICKS(100));
}

static esp_err_t i2c_write_data(const uint8_t *data, size_t len) {
    uint8_t buf[len + 1];
    buf[0] = 0x40;
    memcpy(&buf[1], data, len);
    return i2c_master_write_to_device(I2C_MASTER_NUM, OLED_ADDR, buf, len + 1, pdMS_TO_TICKS(100));
}

void oled_init(void) {
    i2c_master_init();
    
    i2c_write_cmd(0xAE);
    i2c_write_cmd(0xD5); i2c_write_cmd(0x80);
    i2c_write_cmd(0xA8); i2c_write_cmd(0x3F);
    i2c_write_cmd(0xD3); i2c_write_cmd(0x00);
    i2c_write_cmd(0x40);
    i2c_write_cmd(0x8D); i2c_write_cmd(0x14);
    i2c_write_cmd(0x20); i2c_write_cmd(0x00);
    i2c_write_cmd(0xA1);
    i2c_write_cmd(0xC8);
    i2c_write_cmd(0xDA); i2c_write_cmd(0x12);
    i2c_write_cmd(0x81); i2c_write_cmd(0xCF);
    i2c_write_cmd(0xD9); i2c_write_cmd(0xF1);
    i2c_write_cmd(0xDB); i2c_write_cmd(0x40);
    i2c_write_cmd(0xA4);
    i2c_write_cmd(0xA6);
    i2c_write_cmd(0xAF);
    
    ESP_LOGI(TAG, "OLED init done");
}

void oled_off(void) {
    i2c_write_cmd(0x8D);
    i2c_write_cmd(0x10);
    i2c_write_cmd(0xAE);
    ESP_LOGI(TAG, "OLED off");
}

void oled_on(void) {
    i2c_write_cmd(0x8D);
    i2c_write_cmd(0x14);
    i2c_write_cmd(0xAF);
    ESP_LOGI(TAG, "OLED on");
}

void oled_clear(void) {
    memset(oled_buffer, 0, sizeof(oled_buffer));
}

void oled_update(void) {
    esp_rom_delay_us(5000);
    for (int page = 0; page < 8; page++) {
        i2c_write_cmd(0xB0 + page);
        i2c_write_cmd(0x00);
        i2c_write_cmd(0x10);
        i2c_write_data(&oled_buffer[page * OLED_WIDTH], OLED_WIDTH);
        esp_rom_delay_us(2000);
    }
}

void oled_draw_pixel(int x, int y) {
    if (x >= 0 && x < OLED_WIDTH && y >= 0 && y < OLED_HEIGHT) {
        oled_buffer[(y / 8) * OLED_WIDTH + x] |= (1 << (y % 8));
    }
}

void oled_draw_line(int x0, int y0, int x1, int y1) {
    int dx = abs(x1 - x0);
    int dy = abs(y1 - y0);
    int sx = (x0 < x1) ? 1 : -1;
    int sy = (y0 < y1) ? 1 : -1;
    int err = dx - dy;
    while (1) {
        oled_draw_pixel(x0, y0);
        if (x0 == x1 && y0 == y1) break;
        int e2 = 2 * err;
        if (e2 > -dy) { err -= dy; x0 += sx; }
        if (e2 < dx) { err += dx; y0 += sy; }
    }
}

void oled_draw_rect(int x, int y, int w, int h) {
    oled_draw_line(x, y, x + w - 1, y);
    oled_draw_line(x, y + h - 1, x + w - 1, y + h - 1);
    oled_draw_line(x, y, x, y + h - 1);
    oled_draw_line(x + w - 1, y, x + w - 1, y + h - 1);
}

void oled_fill_rect(int x, int y, int w, int h) {
    for (int i = x; i < x + w; i++) {
        for (int j = y; j < y + h; j++) {
            oled_draw_pixel(i, j);
        }
    }
}

static const uint8_t font6x8[96][8] = {
    {0x00,0x00,0x00,0x00,0x00,0x00,0x00,0x00},
    {0x00,0x00,0x5F,0x00,0x00,0x00,0x00,0x00},
    {0x00,0x07,0x00,0x07,0x00,0x00,0x00,0x00},
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    {0x3C,0x26,0x23,0x26,0x3C,0x00,0x00,0x00},
};

static const uint8_t font8x16[96][16] = {
    {0x00,0x00,0x00,0x00,0x00,0x00,0x00,0x00,0x00,0x00,0x00,0x00,0x00,0x00,0x00,0x00},// Space
    {0x00,0x00,0x00,0xF8,0x00,0x00,0x00,0x00,0x00,0x00,0x00,0x33,0x30,0x00,0x00,0x00},// !
    {0x00,0x10,0x0C,0x06,0x10,0x0C,0x06,0x00,0x00,0x00,0x00,0x00,0x00,0x00,0x00,0x00},// "
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    {0x00,0x06,0x01,0x01,0x02,0x02,0x04,0x04,0x00,0x00,0x00,0x00,0x00,0x00,0x00,0x00} // ~
};

void oled_draw_char(int x, int y, char c) {
    if (c < 32 || c > 127) c = '?';
    if (current_font_size == 0) { // Small font (6x8)
        const uint8_t *glyph = font6x8[(uint8_t)c - 32];
        for (int col = 0; col < 6; col++) {
            uint8_t bits = glyph[col];
            for (int row = 0; row < 8; row++) {
                if (bits & (1 << row)) {
                    oled_draw_pixel(x + col, y + row);
                }
            }
        }
    } else { // Large font (8x16)
        const uint8_t *glyph = font8x16[(uint8_t)c - 32];
        for (int col = 0; col < 8; col++) {
            uint8_t bits1 = glyph[col];
            uint8_t bits2 = glyph[col + 8];
            for (int row = 0; row < 8; row++) {
                if (bits1 & (1 << row)) oled_draw_pixel(x + col, y + row);
                if (bits2 & (1 << row)) oled_draw_pixel(x + col, y + row + 8);
            }
        }
    }
}

void oled_draw_string(int x, int y, const char *str) {
    while (*str) {
        oled_draw_char(x, y, *str);
        x += (current_font_size == 0) ? 6 : 8;
        str++;
    }
}

void oled_draw_progress_bar(int x, int y, int w, int h, int percent) {
    oled_draw_rect(x, y, w, h);
    int fill_w = (w - 2) * percent / 100;
    if (fill_w > 0) {
        oled_fill_rect(x + 1, y + 1, fill_w, h - 2);
    }
}

void oled_set_font_small(void) {
    current_font_size = 0;
}

void oled_set_font_large(void) {
    current_font_size = 1;
}
